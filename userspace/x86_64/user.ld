/* ===========================================================================
 * userspace/x86_64/user.ld — линкер-скрипт для x86_64 user-программ.
 * ---------------------------------------------------------------------------
 * Базовый адрес 0x80_0000_0000 = 512 GB соответствует USER_BASE из vm.h
 * (= start PML4[1]). Это per-process пространство — изоляция между процессами
 * гарантируется тем, что каждый vm_space владеет своим PDPT под PML4[1].
 *
 * MAXPAGESIZE=0x1000 — иначе ld выровняет PT_LOAD на 0x200000 (2 MB) и сделает
 * огромный pad между сегментами в файле.
 * ===========================================================================
 */
ENTRY(_start)
OUTPUT_FORMAT(elf64-x86-64)

/* Явно разделяем RX (text+rodata) и RW (data+bss) сегменты, иначе ld
 * объединит в один PT_LOAD с RWX и наш ELF loader выдаст исполняемый
 * .data — нарушение принципа W^X. */
PHDRS {
    text PT_LOAD FLAGS(5);    /* PF_R | PF_X */
    data PT_LOAD FLAGS(6);    /* PF_R | PF_W */
}

SECTIONS
{
    . = 0x0000008000000000;

    .text   : { *(.text*) }                 :text
    .rodata : { *(.rodata*) }               :text
    .data   : ALIGN(0x1000) { *(.data*) }   :data
    .bss    : { *(.bss*) *(COMMON) }        :data

    /DISCARD/ : { *(.eh_frame) *(.note*) *(.comment) }
}
