/* user_elf.ld - Скрипт линкера для ELF-программ MyOS (Этап 18) */
/* Программы компилируются как полноценные ELF32, а не flat binary */

OUTPUT_FORMAT("elf32-i386")
ENTRY(_start)

SECTIONS {
    /* Базовый адрес загрузки пользовательских программ */
    /* Ядро загрузит сегменты по указанным здесь адресам */
    . = 0x40000000;

    /* Секция кода (исполняемая, только для чтения) */
    .text ALIGN(4K) : {
        *(.text._start)    /* _start всегда первым! */
        *(.text)
        *(.text.*)
    }

    /* Секция данных только для чтения */
    .rodata ALIGN(4K) : {
        *(.rodata)
        *(.rodata.*)
    }

    /* Секция инициализированных данных (чтение + запись) */
    .data ALIGN(4K) : {
        *(.data)
        *(.data.*)
    }

    /* Секция неинициализированных данных (BSS) */
    .bss ALIGN(4K) : {
        __bss_start = .;
        *(COMMON)
        *(.bss)
        *(.bss.*)
        __bss_end = .;
    }

    /* Конец программы */
    _end = .;

    /* Отбрасываем ненужные секции */
    /DISCARD/ : {
        *(.comment)
        *(.note.*)
        *(.eh_frame)
        *(.eh_frame_hdr)
    }
}
